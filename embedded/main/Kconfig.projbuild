## embedded/main/Kconfig.projbuild
```kconfig
menu "YX Gateway Debug Options"

config GW_DEBUG_CONSOLE
    bool "Enable local debug console"
    default n
    help
        Enable the local debug console. Release builds should keep this disabled.

config GW_DEBUG_MQTT_TRACE
    bool "Enable MQTT trace logs"
    default n
    help
        Enable verbose MQTT send/receive trace logs for diagnostics.

config GW_DEBUG_HTTP_TRACE
    bool "Enable HTTP trace logs"
    default n
    help
        Enable verbose HTTP trace logs for diagnostics.

config GW_DEBUG_SCRIPT_TRACE
    bool "Enable script runtime trace logs"
    default n
    help
        Enable verbose MicroPython runtime trace logs for diagnostics.

config GW_FAULT_INJECT
    bool "Enable fault injection hooks"
    default n
    help
        Enable fault injection hooks used by development tests only.

endmenu
```

## embedded/sdkconfig.defaults
```kconfig
CONFIG_IDF_TARGET="esp32s3"
CONFIG_PARTITION_TABLE_CUSTOM=y
CONFIG_PARTITION_TABLE_CUSTOM_FILENAME="partitions.csv"
CONFIG_PARTITION_TABLE_FILENAME="partitions.csv"
CONFIG_PARTITION_TABLE_OFFSET=0x8000
CONFIG_ESPTOOLPY_FLASHSIZE_16MB=y
CONFIG_ESPTOOLPY_FLASHSIZE="16MB"
CONFIG_SPIRAM=y
CONFIG_SPIRAM_MODE_OCT=y
CONFIG_SPIRAM_BOOT_INIT=y
CONFIG_SPIRAM_USE_MALLOC=y
# 普通对象优先使用 PSRAM，并为任务栈、USB DMA 等片内专用分配保留足够空间。
CONFIG_SPIRAM_MALLOC_ALWAYSINTERNAL=4096
CONFIG_SPIRAM_MALLOC_RESERVE_INTERNAL=65536
# CONFIG_FREERTOS_TASK_CREATE_ALLOW_EXT_MEM is not set
# HTTPS 握手缓冲较大，放到 PSRAM，避免挤占驱动、任务栈和脚本运行所需的内部 RAM。
# CONFIG_MBEDTLS_INTERNAL_MEM_ALLOC is not set
CONFIG_MBEDTLS_EXTERNAL_MEM_ALLOC=y
CONFIG_MQTT_USE_CUSTOM_CONFIG=y
CONFIG_MQTT_OUTBOX_DATA_ON_EXTERNAL_MEMORY=y
CONFIG_ESP_MAIN_TASK_STACK_SIZE=16384
CONFIG_USB_HOST_ENABLE_ENUM_FILTER_CALLBACK=y

# BLE 配置通道仅启用单连接 NimBLE 外设，host 动态内存优先放入 PSRAM。
CONFIG_BT_ENABLED=y
CONFIG_BT_CONTROLLER_ENABLED=y
CONFIG_BT_NIMBLE_ENABLED=y
# CONFIG_BT_BLUEDROID_ENABLED is not set
CONFIG_BT_NIMBLE_MEM_ALLOC_MODE_EXTERNAL=y
CONFIG_BT_NIMBLE_HOST_TASK_STACK_SIZE=8192
CONFIG_BT_NIMBLE_ROLE_PERIPHERAL=y
CONFIG_BT_NIMBLE_ROLE_BROADCASTER=y
# CONFIG_BT_NIMBLE_ROLE_CENTRAL is not set
# CONFIG_BT_NIMBLE_ROLE_OBSERVER is not set
# CONFIG_BT_NIMBLE_GATT_CLIENT is not set
CONFIG_BT_NIMBLE_GATT_SERVER=y
CONFIG_BT_NIMBLE_SECURITY_ENABLE=y
# CONFIG_BT_NIMBLE_SM_LEGACY is not set
CONFIG_BT_NIMBLE_SM_SC=y
# No Input/No Output 的 Just Works 不具备 MITM 认证能力；SC Only 会把所有
# 加密特征提升为认证级别 4，导致已加密连接仍被 GATT 拒绝。
CONFIG_BT_NIMBLE_SM_SC_ONLY=0
CONFIG_BT_NIMBLE_NVS_PERSIST=y
CONFIG_BT_NIMBLE_MAX_BONDS=1
CONFIG_BT_NIMBLE_MAX_CONNECTIONS=1
CONFIG_BT_NIMBLE_MAX_CCCDS=4
CONFIG_BT_NIMBLE_ATT_PREFERRED_MTU=256
CONFIG_BT_CTRL_BLE_MAX_ACT=2
```
